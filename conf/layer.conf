## conf/layer.conf
```bitbake
BBFILES += "${LAYERDIR}/recipes-*/*/*.bb ${LAYERDIR}/recipes-*/*/*.bbappend "
BBPATH .= ":${LAYERDIR}"
BBFILE_COLLECTIONS += "meta-mplane"
BBFILE_PRIORITY_meta-mplane = "12"
BBFILE_PATTERN_meta-mplane := "^${LAYERDIR}/"

LAYERSERIES_COMPAT_meta-mplane = "thud dunfell"
```
